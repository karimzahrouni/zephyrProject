## CMakeLists.txt
```
# SPDX-License-Identifier: Apache-2.0

cmake_minimum_required(VERSION 3.20.0)
set(CMAKE_C_STANDARD 11)

add_compile_options(-std=c11)
find_package(Zephyr REQUIRED HINTS $ENV{ZEPHYR_BASE})
project(network)

target_include_directories(app PRIVATE inc)
target_sources(app PRIVATE src/main.c src/network.c)
```

## prj.conf
```kconfig
# GPIO
CONFIG_GPIO=y

# UART
CONFIG_SERIAL=y
CONFIG_UART_INTERRUPT_DRIVEN=y

# Networking
CONFIG_NETWORKING=y
CONFIG_NET_LOG=y
CONFIG_NET_STATISTICS=y
CONFIG_NET_SOCKETS=y
CONFIG_POSIX_API=y
CONFIG_POSIX_MAX_FDS=6
CONFIG_NET_SOCKETS_LOG_LEVEL_DBG=n
CONFIG_NET_SOCKETS_POLL_MAX=4
CONFIG_NET_IPV6=n
CONFIG_NET_IPV4=y
CONFIG_NET_ARP=y
CONFIG_NET_TCP=y
CONFIG_NET_UDP=y
CONFIG_NET_DHCPV4=y
CONFIG_NET_SHELL=y
CONFIG_NET_MGMT=y
CONFIG_NET_MGMT_EVENT=y
CONFIG_NET_MGMT_EVENT_STACK_SIZE=1024
CONFIG_INIT_STACKS=y
CONFIG_SLIP_STATISTICS=n
CONFIG_TEST_RANDOM_GENERATOR=y
```

## boards/arm/nucleo_f429zi.overlay
```dts
/ {
  aliases {
      led0 = &my_led0;
  };

  leds {
      compatible = "gpio-leds";
      my_led0: led_0 {
          gpios = <&gpiob 14 GPIO_ACTIVE_LOW>;
          label = "User LED 0";
      };
  };
};
```

## src/main.c
```c
#include <zephyr/kernel.h>
#include <zephyr/drivers/gpio.h>
#include <zephyr/net/socket.h>
#include <zephyr/logging/log.h>

#include "network.h"

LOG_MODULE_REGISTER(LOG_LEVEL_INF);

/* The devicetree node identifier for the "ledUser2" alias. */
#define LED0_NODE DT_ALIAS(led0)

/* LED status */
#define LED_ON            GPIO_PIN_RESET
#define LED_OFF           GPIO_PIN_SET

/* Server config */
#define SERVER_PORT       5000

/*
 * A build error on this line means your board is unsupported.
 * See the sample documentation for information on how to fix this.
 */
static const struct gpio_dt_spec led = GPIO_DT_SPEC_GET(LED0_NODE, gpios);
static const char* led_on_buf = "LED TURNED ON\n";
static const char* led_off_buf = "LED TURNED OFF\n";

/* Server file descriptor */
static int server_fd = -1;

/* Callback when IP is obtained */
static void on_ip(const char *ip)
{
  /* Use %s directly if log_strdup not available */
  LOG_INF("MY Device IP: %s", ip);
}

/* LEDs initialization */
static int led_init(void)
{
  int ret;

  if (!gpio_is_ready_dt(&led))
  {
    ret = -1;
  }

  ret = gpio_pin_configure_dt(&led, GPIO_OUTPUT_ACTIVE);

  return ret;
}

void main(void)
{
  struct sockaddr_in server_addr, client_addr;
  socklen_t client_addr_len = sizeof(client_addr);
  char recv_buf[128];
  int client_fd;

  /* Leds initialization */
	led_init();

  /* Initialize network module */
  network_init();

  /* Register IP callback */
  network_register_ip_acquired_callback(on_ip);

  /* Start DHCP */
  network_start();

  server_fd = socket(AF_INET, SOCK_STREAM, IPPROTO_TCP);
  if (server_fd < 0)
  {
    LOG_ERR("Failed to create socket");
    return;
  }

  server_addr.sin_family = AF_INET;
  server_addr.sin_port = htons(SERVER_PORT);
  server_addr.sin_addr.s_addr = INADDR_ANY;

  if (bind(server_fd, (struct sockaddr *)&server_addr, sizeof(server_addr)) < 0)
  {
    LOG_INF("Failed to bind socket");
    return;
  }

  if (listen(server_fd, 1) < 0)
  {
    LOG_INF("Failed to listen");
    return;
  }

  LOG_INF("TCP Server listening on port %d", SERVER_PORT);

  while (1)
  {
    client_fd = accept(server_fd, (struct sockaddr *)&client_addr, &client_addr_len);
    if (client_fd < 0)
    {
      LOG_ERR("Failed to accept client");
      continue;
    }

    LOG_INF("Client connected");

    int len;
    while ((len = recv(client_fd, recv_buf, sizeof(recv_buf) - 1, 0)) > 0)
    {
      recv_buf[len] = '\0';
      LOG_INF("Received: %s", recv_buf);

      /* Turn LED on/off commands */
      if (strncmp(recv_buf, "LED_ON", 6) == 0)
      {
        if (gpio_pin_set_dt(&led, LED_ON) == 0U)
        {
          LOG_INF("Turn LED ON");

          // Echo back
          send(client_fd, led_on_buf, strlen(led_on_buf), 0);
        }
      }
      else if (strncmp(recv_buf, "LED_OFF", 7) == 0)
      {
        if (gpio_pin_set_dt(&led, LED_OFF) == 0U)
        {
          LOG_INF("Turn LED OFF");

          // Echo back
          send(client_fd, led_off_buf, strlen(led_off_buf), 0);
        }
      }
    }

    LOG_INF("Client disconnected");
    close(client_fd);
  }
}
```

## inc/network.h
```c
/***
   * @file network.h
   * @brief Network initialization and DHCP event handling for Zephyr.
   *
   * This module provides functionality to initialize the network interface,
   * start DHCP, and notify the application when an IPv4 address is assigned.
   *
   * @author Zahrouni Karim
   * @date 2025
   */

#ifndef NETWORK_H_
#define NETWORK_H_

#include <stddef.h>

#ifdef __cplusplus
extern "C" {
#endif

typedef void (*network_ip_callback_t)(const char *ip);

/* Initialize module: registers net_mgmt callback and grabs default iface */
int network_init(void);

/* Start DHCPv4 on the default interface */
int network_start(void);

/* Register a callback invoked when a DHCP IPv4 address is obtained */
int network_register_ip_acquired_callback(network_ip_callback_t cb);

#ifdef __cplusplus
}
#endif

#endif /* NETWORK_H_ */
```

## src/network.c
```c
/***
   * @file network.h
   * @brief Network initialization and DHCP event handling for Zephyr.
   *
   * This module provides functionality to initialize the network interface,
   * start DHCP, and notify the application when an IPv4 address is assigned.
   *
   * @author Zahrouni Karim
   * @date 2025
   */

#include <zephyr/logging/log.h>
#include <zephyr/net/net_core.h>
#include <zephyr/net/net_if.h>
#include <zephyr/net/net_ip.h>
#include <zephyr/net/net_mgmt.h>
#include <zephyr/net/net_event.h>
#include <zephyr/net/dhcpv4.h>

#include "network.h"

LOG_MODULE_REGISTER(Network, LOG_LEVEL_INF);

/**
 * @brief Network context structure for internal state management.
 */
struct network_ctx
{
  struct net_if *p_iface;                    /**< Pointer to the active network interface */
  struct net_mgmt_event_callback mgmt_cb;    /**< Network management event callback handle */
  network_ip_callback_t p_cb;                /**< User callback when an IP is assigned */
  bool is_initialized;                       /**< Flag to check if initialized */
};

static struct network_ctx g_net = {0};

/**
 * @brief Network management event handler.
 * This handler reacts to IPv4 address assignment events and invokes
 * the registered user callback with the assigned IP address.
 * @param p_cb     Network management event callback (unused).
 * @param event    Network management event code.
 * @param p_iface  Network interface associated with the event.
 */
static void mgmt_handler(struct net_mgmt_event_callback *p_cb,
                         uint32_t event, struct net_if *p_iface)
{
  ARG_UNUSED(p_cb);

  if (event != NET_EVENT_IPV4_ADDR_ADD)
  {
    return;
  }

  /* Ensure IPv4 configuration exists */
  if (!p_iface || !p_iface->config.ip.ipv4)
  {
    return;
  }

  const struct net_if_addr_ipv4 *p_ua = &p_iface->config.ip.ipv4->unicast[0];

  /* Only process DHCP-assigned addresses */
  if (p_ua->ipv4.addr_type != NET_ADDR_DHCP)
	{
    return;
  }

  char ip_buf[NET_IPV4_ADDR_LEN] = {0};

  if (!net_addr_ntop(AF_INET, &p_ua->ipv4.address.in_addr, ip_buf, sizeof(ip_buf)))
  {
    LOG_ERR("Failed to convert IPv4 to string");
    return;
  }

  LOG_INF("Got IP: %s", ip_buf);

  if (g_net.p_cb)
  {
    g_net.p_cb(ip_buf);
  }
}

/**
 * @brief Initialize the network module.
 * This function sets up the default network interface and registers
 * the management event callback for IPv4 address assignment.
 * @return 0 on success, negative error code on failure.
 */
int network_init(void)
{
  if (g_net.is_initialized)
  {
    return 0;
  }

  g_net.p_iface = net_if_get_default();
  if (!g_net.p_iface)
  {
    LOG_ERR("No default network interface");
    return -ENODEV;
  }

  net_mgmt_init_event_callback(&g_net.mgmt_cb,
                              mgmt_handler,
	                            NET_EVENT_IPV4_ADDR_ADD);

  net_mgmt_add_event_callback(&g_net.mgmt_cb);

  g_net.is_initialized = true;

  return 0;
}

/**
 * @brief Start the network connection using DHCP.
 * This function starts the DHCPv4 client on the default interface.
 * @return 0 on success, negative error code on failure.
 */
int network_start(void)
{
  if (!g_net.is_initialized)
  {
    int rc = network_init();
    if (rc)
    {
      return rc;
    }
  }

  net_dhcpv4_start(g_net.p_iface);

  return 0;
}

/**
 * @brief Register a callback to be called when an IP address is assigned.
 * @param p_cb  Callback function to invoke with the assigned IP string.
 * @return 0 on success, negative error code if the callback is NULL.
 */
int network_register_ip_acquired_callback(network_ip_callback_t p_cb)
{
  if (p_cb == NULL)
  {
    LOG_ERR("NULL callback");
    return -EINVAL;
  }

  g_net.p_cb = p_cb;
  return 0;
}
```
