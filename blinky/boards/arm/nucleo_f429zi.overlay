/ {
	aliases {
			led0 = &my_led0;
	};

	leds {
			compatible = "gpio-leds";
			my_led0: led_0 {
					gpios = <&gpiob 14 GPIO_ACTIVE_LOW>; // Example: GPIO0, pin 13, active low
					label = "custom User LED 0";
			};
	};
};