/ {
  aliases {
      led0 = &my_led0;
  };

  leds {
      compatible = "gpio-leds";
      my_led0: led_0 {
          gpios = <&gpiob 7 GPIO_ACTIVE_LOW>;
          label = "User LED";
      };
  };
};